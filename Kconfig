## Kconfig
```kconfig
#
# Copyright (C) 2008-2010 Freescale Semiconductor, Inc.
#
# Redistribution and use in source and binary forms, with or without
# modification, are permitted provided that the following conditions
# are met:
# 1. Redistributions of source code must retain the above copyright
#    notice, this list of conditions and the following disclaimer.
# 2. Redistributions in binary form must reproduce the above copyright
#    notice, this list of conditions and the following disclaimer in the
#    documentation and/or other materials provided with the distribution.
#
#  THIS SOFTWARE IS PROVIDED BY THE AUTHOR "AS IS" AND ANY EXPRESS OR
#  IMPLIED WARRANTIES, INCLUDING, BUT NOT LIMITED TO, THE IMPLIED WARRANTIES
#  OF MERCHANTABILITY AND FITNESS FOR A PARTICULAR PURPOSE ARE DISCLAIMED.  IN
#  NO EVENT SHALL THE AUTHOR BE LIABLE FOR ANY DIRECT, INDIRECT, INCIDENTAL,
#  SPECIAL, EXEMPLARY, OR CONSEQUENTIAL DAMAGES (INCLUDING, BUT NOT LIMITED
#  TO, PROCUREMENT OF SUBSTITUTE GOODS OR SERVICES; LOSS OF USE, DATA, OR
#  PROFITS; OR BUSINESS INTERRUPTION) HOWEVER CAUSED AND ON ANY THEORY OF
#  LIABILITY, WHETHER IN CONTRACT, STRICT LIABILITY, OR TORT (INCLUDING
#  NEGLIGENCE OR OTHERWISE) ARISING IN ANY WAY OUT OF THE USE OF THIS
#  SOFTWARE, EVEN IF ADVISED OF THE POSSIBILITY OF SUCH DAMAGE.
#

config PROJECTVERSION
	string
	option env="PROJECTVERSION"

config MAJORVERSION
	int
	option env="VERSION"

config SUBVERSION
	int
	option env="SUBVERSION"

config HV_VERSION
	string
	default PROJECTVERSION

config HV_MAJOR_VERSION
	int
	default MAJORVERSION

config HV_MINOR_VERSION
	int
	default SUBVERSION

source "libos/lib/Kconfig"

config LIBOS_DEPS
	bool
	default y
	select LIBOS_INIT
	select LIBOS_EXCEPTION
	select LIBOS_LIBC
	select LIBOS_MALLOC
	select LIBOS_FSL_BOOKE_TLB
	select LIBOS_MPIC
	select LIBOS_CONSOLE
	select LIBOS_MP
	select LIBOS_VIRT_ALLOC
	select LIBOS_DRIVER_MODEL
	select LIBOS_THREADS
	select LIBOS_SCHED_API
	select LIBOS_CRITICAL_INTS
	select LIBOS_NO_BARE_SPINLOCKS

config 64BIT
	bool "64-bit Processor Support"
	help
		Provides support for a 64-bit processor

config GCC_CPU_FLAG
	string "Processor specific compiler optimizations"
	default "e500mc"
	help
		Provides compiler flag for processor specific optimizations

config P4080_ERRATUM_PAMU3
	bool
	default y

config BYTE_CHAN
	bool "Byte-channel support"
	select LIBOS_QUEUE
	help
		Byte channels are a bidirectional pipe mechanism that
		allows communication between guests, character devices,
		multiplexers, and other components.

config BCMUX
	bool "Byte-channel multiplexer"
	depends on BYTE_CHAN
	help
		Byte channel multiplexing creates virtual channels over
		a single combined byte channel.  It is useful for, among
		other things, sharing a single serial port for the
		consoles of all guests.

config SHELL
	bool "Command-line shell"
	select LIBOS_QUEUE
	select LIBOS_READLINE
	help
		A command-line shell with various debugging and
		configuration commands.

config PAMU
	bool "PAMU/IOMMU support"
	select LIBOS_PAMU
	help
		Provides support for Peripheral Access Management Unit.

config TLB_CACHE
	bool "Cache TLB entries"
	help
		Rather than sending TLB misses directly to the guest,
		a larger TLB is maintained by the hypervisor in software,
		from which the hypervisor satisfies most TLB misses.  Only
		when an access misses the larger TLB cache will the guest's
		TLB miss handler be invoked.
		
		Besides improving performance, this option removes
		restrictions on size and alignment of TLB1 entries, and
		improves the handling of access holes within TLB1 entries.

		The cost of this option with the default cache size is
		256KiB per core, and the possibility of some small added
		latency when accessing pages that the guest believes are
		pinned to TLB1.

config DEVICE_VIRT
	# Core support for device virtualization.  Enable this if you
	# want to be able to virtual devices that share a page or
	# interrupt, like I2C.
	bool

config VIRTUAL_I2C
	bool "I2C virtualization"
	select DEVICE_VIRT
	help
		Enable this option if you want access to I2C devices
		to be protected across partitions.  The I2C block
		has two I2C controllers on it.  The two controllers share
		the same page of memory and the same interrupt number.
		This feature enables protection of the memory space and
		virtualization of the interrupts, so that one I2C
		controller can be assigned to one partition, and the other
		I2C controller can be assigned to another partition, and
		neither partition will be able to access the I2C registers
		of the other.

config VIRTUAL_PCIE
	bool "PCIe controller virtualization"
	select DEVICE_VIRT
	help
		Enable PCIe host controller virtualization support.

config STATISTICS
	bool "Hypervisor statistics"
	select LIBOS_STATISTICS
	help
		Detailed hypervisor emulated instruction statistics.
		Gives a count of emulated instructions executed.

config ZLIB
	bool "Compressed uImage Support"
	help
		Enable this option to support compressed uImage
		(u-boot image format) images being loaded 
		by the hypervisor when specified in the guest-image
		or load-image-table properties in the configuration
		device tree.

config DEBUG_STUB
	bool "Debug Stub Support"
	depends on BYTE_CHAN
	help
		Enable debug stub support.  This allows you to debug the guest
		remotely with a host debugger.

config GDB_STUB
	bool "GDB Stub Support"
	depends on DEBUG_STUB
	help
		Enable GDB stub support.  This allows you to debug the guest 
		remotely with GDB.  The stub is located in the hypervisor, 
		allowing non-intrusive debugging.

config HYPERTRK
	bool "CodeWarrior HyperTRK Stub Support"
	depends on DEBUG_STUB
	help
		Enable CodeWarrior HyperTRK debug stub support.  This allows
                debugging of a a guest remotely with CodeWarrior.  The stub
                is located in the hypervisor, allowing non-intrusive debugging.

config DEBUG_STUB_PROGRAM_INTERRUPT
	bool "Use program interrupt for debugging"
	depends on DEBUG_STUB
	help
		Specifies that the debug stub should use program interrupts
		instead of the debug interrupt for debugging.  Use this 
		option to enable guest debugging with a debug stub at the
		same time 'guest debug mode' has been granted to a guest.
		NOTE: program interrupt debugging has limitations in an
		SMP partition.

config BENCHMARKS
	bool "Microbenchmarks"
	depends on STATISTICS
	help
		Enable benchmark code that measures the average, minimum,
		and maximum amount of time it takes to run certain
		pieces of hypervisor code.  This information can be
		displayed by using the "benchmark" command.

config PM
	bool "Power Management"
	help
		Enable support for power management hypercalls and sleep
		states.  Note that the idle hcall is considered base
		functionality and is enabled regardless of this option.
```

## test/Kconfig
```kconfig
#
# Copyright (C) 2008-2010 Freescale Semiconductor, Inc.
#
# Redistribution and use in source and binary forms, with or without
# modification, are permitted provided that the following conditions
# are met:
# 1. Redistributions of source code must retain the above copyright
#    notice, this list of conditions and the following disclaimer.
# 2. Redistributions in binary form must reproduce the above copyright
#    notice, this list of conditions and the following disclaimer in the
#    documentation and/or other materials provided with the distribution.
#
#  THIS SOFTWARE IS PROVIDED BY THE AUTHOR "AS IS" AND ANY EXPRESS OR
#  IMPLIED WARRANTIES, INCLUDING, BUT NOT LIMITED TO, THE IMPLIED WARRANTIES
#  OF MERCHANTABILITY AND FITNESS FOR A PARTICULAR PURPOSE ARE DISCLAIMED.  IN
#  NO EVENT SHALL THE AUTHOR BE LIABLE FOR ANY DIRECT, INDIRECT, INCIDENTAL,
#  SPECIAL, EXEMPLARY, OR CONSEQUENTIAL DAMAGES (INCLUDING, BUT NOT LIMITED
#  TO, PROCUREMENT OF SUBSTITUTE GOODS OR SERVICES; LOSS OF USE, DATA, OR
#  PROFITS; OR BUSINESS INTERRUPTION) HOWEVER CAUSED AND ON ANY THEORY OF
#  LIABILITY, WHETHER IN CONTRACT, STRICT LIABILITY, OR TORT (INCLUDING
#  NEGLIGENCE OR OTHERWISE) ARISING IN ANY WAY OUT OF THE USE OF THIS
#  SOFTWARE, EVEN IF ADVISED OF THE POSSIBILITY OF SUCH DAMAGE.
#

source "libos/lib/Kconfig"

config GUEST64
	bool
	option env="GUEST64"

config LIBOS_DEPS
	bool
	default y
	select LIBOS_HV_GUEST
	select LIBOS_INIT
	select LIBOS_EXCEPTION
	select LIBOS_LIBC
	select LIBOS_SIMPLE_ALLOC
	select LIBOS_FSL_BOOKE_TLB
	select LIBOS_CONSOLE
	select LIBOS_MP
	select LIBOS_VIRT_ALLOC
	select LIBOS_NS16550
	select LIBOS_QUEUE
	select LIBOS_BYTE_CHAN
	select LIBOS_64BIT if GUEST64
	select LIBOS_POWERISA206
	select LIBOS_POWERISA_E_PC
	select LIBOS_POWERISA_E_ED
config GCC_CPU_FLAG
	string
	default e500mc if !GUEST64
	default e5500  if GUEST64
```
